## 源代码/board/Kconfig
```kconfig
menu "Hardware Drivers Config"

config SOC_STM32F103RB
    bool
    select SOC_SERIES_STM32F1
    default y

menu "Onboard Peripheral Drivers"
	config BSP_USING_MOTOR
        bool "Enable MOTOR"
		select RT_USING_HWTIMER
        default y
	config BSP_USING_MUP9250
        bool "Enable MUP9250"
		select BSP_USING_I2C
		select BSP_USING_I2C1
        default y
	config BSP_USING_ROS_BASE_CTL
        bool "Enable ROS base control"
		select BSP_USING_UART4
        default y
endmenu

menu "On-chip Peripheral Drivers"

    config BSP_USING_GPIO
        bool "Enable GPIO"
        select RT_USING_PIN
        default y

    menuconfig BSP_USING_UART
        bool "Enable UART"
        default y
        select RT_USING_SERIAL
        if BSP_USING_UART
            config BSP_USING_UART2
                bool "Enable UART2"
                default y
            config BSP_UART2_RX_USING_DMA
                bool "Enable UART2 RX DMA"
                depends on BSP_USING_UART2 && RT_SERIAL_USING_DMA
                default n
			config BSP_USING_UART4
                bool "Enable UART4"
                default y
				
        endif
		
	menuconfig BSP_USING_I2C
        bool "Enable I2C BUS"
        default y
        select RT_USING_I2C
        select RT_USING_I2C_BITOPS
        select RT_USING_PIN
        if BSP_USING_I2C
            menuconfig BSP_USING_I2C1
				select I2C1_BUS_CONFIG
                bool "Enable I2C1 BUS (software simulation)"
                default y
                if BSP_USING_I2C1
                    comment "Notice: PB8 --> 24; PB9 --> 25" 
                    config BSP_I2C1_SCL_PIN
                        int "i2c1 scl pin number"
                        range 1 176
                        default 24
                    config BSP_I2C1_SDA_PIN
                        int "I2C1 sda pin number"
                        range 1 176
                        default 25
                endif
        endif

endmenu

menu "Board extended module Drivers"

endmenu

endmenu
```
